## net/mosquitto/Config.in
```kconfig
config MOSQUITTO_LWS
    bool "libwebsockets support"
    depends on PACKAGE_mosquitto-ssl
    default y
    help
        Includes websockets support in the broker, via libwebsockets

config MOSQUITTO_CTRL
    bool "Include mosquitto_ctrl utility"
    depends on PACKAGE_mosquitto-ssl
    default y
    help
        mosquitto_ctrl is a tool for managing the broker at run time.

config MOSQUITTO_DYNAMIC_SECURITY
    bool "Install mosquitto_dynamic_security.so"
    depends on PACKAGE_mosquitto-ssl
    default y
    help
        This enables the dynamic security modes documented at
        https://mosquitto.org/documentation/dynamic-security/
        but does add ~88kB.  If you're not using it, you can disable it

config MOSQUITTO_PASSWD
    bool "Include mosquitto_passwd utility"
    depends on PACKAGE_mosquitto-ssl
    default y
    help
        mosquitto_passwd is a tool for managing password files for mosquitto.

config MOSQUITTO_DB_DUMP
	bool "Include persistence database analysis tool"
	depends on PACKAGE_mosquitto-ssl
	default n
	help
		mosquitto_db_dump is a tool for dumping statistics/messages
		from a mosquitto persistence file. This can only dump, not edit,
		and is not a tool you normally need.
```
